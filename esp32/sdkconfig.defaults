## esp32/sdkconfig.defaults
```kconfig
# ESP32 Configuration
CONFIG_IDF_TARGET="esp32"

# Bluetooth Configuration  
CONFIG_BT_ENABLED=y
CONFIG_BTDM_CTRL_MODE_BLE_ONLY=y
CONFIG_BT_BLUEDROID_ENABLED=y
CONFIG_BT_GATTS_ENABLE=y

# FreeRTOS Configuration
CONFIG_FREERTOS_HZ=1000

# Component Configuration
CONFIG_ESP_TIMER_PROFILING=y

# Serial flasher config
CONFIG_ESPTOOLPY_FLASHSIZE_4MB=y

# Enforce bonding
CONFIG_BT_BLE_BONDING=y
CONFIG_BT_BLE_MAX_BONDED_DEV=8
```
